## Kconfig
```kconfig
# No backlight control for now
menu "GC9A01 Display Config"
    config GC9A01_WIDTH
        int "GC9A01 Display Width"
        range 64 1024
        default 240

    config GC9A01_HEIGHT
        int "GC9A01 Display Height"
        range 64 1024
        default 240
    #---------------------------------------------
    choice GC9A01_SPI_HOST
        prompt "GC9A01 SPI HOST"
        default USE_SPI2_HOST
        help
            Hardware SPI , HSPI=SPI2 , VSPI=SPI3

        config USE_SPI1_HOST
            bool "Use SPI1"
        config USE_SPI2_HOST
            bool "Use SPI2"
        config USE_SPI3_HOST
            bool "Use SPI3"
        config USE_SPI4_HOST
            bool "Use SPI4"
    endchoice

    config GC9A01_SPI_HOST
        int
        default 0 if USE_SPI1_HOST
        default 1 if USE_SPI2_HOST
        default 2 if USE_SPI3_HOST
        default 3 if USE_SPI4_HOST
    #---------------------------------------------

    config GC9A01_PIN_NUM_SCK
        int "LCD SPI SCK Pin"
        range 0 34
        default 18
        help
            Must Support SPI SCK

    config GC9A01_PIN_NUM_MOSI
        int "LCD SPI MOSI Pin"
        range 0 34
        default 23
        help
            Must Support SPI MOSI

    config GC9A01_PIN_NUM_CS
        int "LCD SPI CS Pin"
        range 0 34
        default 05

    config GC9A01_PIN_NUM_DC
        int "LCD DC(Data or Command) GPIO Pin Number"
        range 0 34
        default 25

    config GC9A01_SPI_SCK_FREQ_M
        int "SPI Clock Freq in MHz"
        range 1 80
        default 40

    #---------------------------------------------

    config GC9A01_RESET_USED
        bool "GC9A01 RESET Pin Used"
        default y
        help
            Use GC9A01 Hard Reset Pin

    config GC9A01_PIN_NUM_RST
        int "LCD RST GPIO Pin Number"
        depends on GC9A01_RESET_USED
        range 0 34
        default 26

    config GC9A01_BUFFER_MODE
        bool "Enable Buffer Mode"
        default n
        help
            Disable for Direct Mode
    # config GC9A01_BUFFER_MODE_PSRAM
    #     bool "Enable buffer allocation on PSRAM"
    #     default n
    #     depends on GC9A01_BUFFER_MODE
    #     help
    #         Allocates Buffer in PSRAM instead of internal
    #         Only working for ESP32-S3 family with PSRAM


endmenu
```
